## components/esp32_p4_wifi6_touch_lcd_xc/Kconfig
```kconfig
menu "Board Support Package(ESP32-P4)"

    config BSP_ERROR_CHECK
        bool "Enable error check in BSP"
        default y
        help
            Error check assert the application before returning the error code.

    menu "I2C"
        config BSP_I2C_NUM
            int "I2C peripheral index"
            default 0
            range 0 1
            help
                ESP32P4 has two I2C peripherals, pick the one you want to use.
                The AllSky display driver spec uses I2C port 0 for the GT911 touch bus.

        config BSP_I2C_FAST_MODE
            bool "Enable I2C fast mode"
            default y
            help
                I2C has two speed modes: normal (100kHz) and fast (400kHz).

        config BSP_I2C_CLK_SPEED_HZ
            int
            default 400000 if BSP_I2C_FAST_MODE
            default 100000
    endmenu

    menu "SPIFFS - Virtual File System"
        config BSP_SPIFFS_FORMAT_ON_MOUNT_FAIL
            bool "Format SPIFFS if mounting fails"
            default n
            help
                Format SPIFFS if it fails to mount the filesystem.

        config BSP_SPIFFS_MOUNT_POINT
            string "SPIFFS mount point"
            default "/spiffs"
            help
                Mount point of SPIFFS in the Virtual File System.

        config BSP_SPIFFS_PARTITION_LABEL
            string "Partition label of SPIFFS"
            default "storage"
            help
                Partition label which stores SPIFFS.

        config BSP_SPIFFS_MAX_FILES
            int "Max files supported for SPIFFS VFS"
            default 5
            help
                Supported max files for SPIFFS in the Virtual File System.
    endmenu

    menu "Display"
        config BSP_LCD_DPI_BUFFER_NUMS
            int "Set number of frame buffers"
            default 3
            range 1 3
            help
                Let DPI LCD driver create a specified number of frame-size buffers. Only when it
                is set to multiple can the tearing-avoidance mode be turned on.

        config BSP_DISPLAY_BRIGHTNESS_LEDC_CH
            int "LEDC channel index"
            default 1
            range 0 7
            help
                LEDC channel used to generate the PWM signal that controls display brightness.

        choice BSP_LCD_COLOR_FORMAT
            prompt "Select LCD color format"
            default BSP_LCD_COLOR_FORMAT_RGB565
            help
                Select the LCD color format RGB565/RGB888.

            config BSP_LCD_COLOR_FORMAT_RGB565
                bool "RGB565"
            config BSP_LCD_COLOR_FORMAT_RGB888
                bool "RGB888"
        endchoice

        # NOTE: There is deliberately no LCD-type choice here. The panel variant
        # (3.4" 800x800 vs 4.0" 720x720) is selected by the single project-level
        # Kconfig choice ALLSKY_PANEL_* in main/Kconfig.projbuild, which this BSP's
        # display.h and init sequence read directly. Keeping one switch prevents the
        # resolution and the init-byte from ever disagreeing.
    endmenu

endmenu
```

## main/Kconfig.projbuild
```kconfig
menu "AllSky Display"

    choice ALLSKY_PANEL
        prompt "Round DSI panel variant (first-boot default only)"
        default ALLSKY_PANEL_3_4
        help
            FIRST-BOOT DEFAULT ONLY. Both round panels are supported at runtime from a single
            binary; the active panel is selected from persisted configuration (NVS key disp_type,
            changeable in the web UI, restart required to apply). This choice only sets the value
            of disp_type on a fresh device with no stored configuration. It does NOT compile out
            either panel: the BSP and the app display profile pick the panel at runtime.

        config ALLSKY_PANEL_3_4
            bool "3.4 inch round, 800x800 (type id 1, default)"
            help
                First-boot disp_type = 1. Waveshare 3.4-inch round DSI panel, JD9365 reg 0x40 = 0x00.

        config ALLSKY_PANEL_4_0
            bool "4.0 inch round, 720x720 (type id 2)"
            help
                First-boot disp_type = 2. Waveshare 4.0-inch round DSI panel
                (ESP32-P4-WIFI6-Touch-LCD-4C), JD9365 reg 0x40 = 0x04.
    endchoice

endmenu
```
